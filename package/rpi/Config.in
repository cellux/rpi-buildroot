## package/rpi/Config.in
```kconfig
menu "Raspberry Pi"
source "package/rpi/rpi-config/Config.in"
source "package/rpi/rpi-firmware/Config.in"
source "package/rpi/rpi-tools/Config.in"
source "package/rpi/rpi-userland/Config.in"
source "package/rpi/libuv/Config.in"
endmenu
```

## package/rpi/libuv/Config.in
```kconfig
config BR2_PACKAGE_LIBUV
	bool "libuv"
	help
	  libuv from node.js
	  
	  http://github.com/joyent/libuv/
```

## package/rpi/rpi-config/Config.in
```kconfig
config BR2_PACKAGE_RPI_CONFIG
	bool "Raspberry Pi config.txt (for /boot)"
	help
	  Heavily commented Raspberry Pi config file
	  
	  https://github.com/Evilpaul/RPi-config

config BR2_PACKAGE_RPI_CONFIG_CMDLINE
	string "Linux kernel command line"
	default "dwc_otg.lpm_enable=0 console=tty1 elevator=deadline rootwait ip=dhcp root=/dev/mmcblk0p2 rootfstype=ext4"
	help
	  This string be written to /boot/cmdline.txt
```

## package/rpi/rpi-firmware/Config.in
```kconfig
config BR2_PACKAGE_RPI_FIRMWARE
	bool "Raspberry Pi GPU firmware + boot files"
	help
	  If you select this, you'll get a bootfs.tar.gz in output/images
	  with a filesystem ready to be written to the first partition
	  of the Raspberry Pi SD card.
	  
	  https://github.com/raspberrypi/firmware

config BR2_PACKAGE_RPI_FIRMWARE_CMDLINE
	string "Linux kernel command line"
	default "dwc_otg.lpm_enable=0 console=tty1 elevator=deadline rootwait ip=dhcp root=/dev/mmcblk0p2 rootfstype=ext4"
	help
	  String to be written to /boot/cmdline.txt
```

## package/rpi/rpi-tools/Config.in
```kconfig
config BR2_PACKAGE_RPI_TOOLS
	bool "Raspberry Pi tools (for mkimage)"
	help
	  Raspberry Pi tools
	  
	  Contains imagetool-uncompressed.py, which is needed
	  for creation of the kernel image.
	  
	  https://github.com/raspberrypi/tools
```

## package/rpi/rpi-userland/Config.in
```kconfig
config BR2_PACKAGE_RPI_USERLAND
	bool "Raspberry Pi userland"
	help
	  Raspberry Pi Userland
	  
	  https://github.com/raspberrypi/userland/
```
